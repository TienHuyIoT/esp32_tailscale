## examples/pc_control/main/Kconfig.projbuild
```kconfig
menu "Example Configuration"

    menu "PC Control - API"

        config PCCTL_API_TOKEN
            string "Initial API token for browser UI -> ESP32 mutations (empty = disabled)"
            default ""
            help
                First-boot default for the shared secret required
                (X-PC-Token or Authorization: Bearer) on every POST under
                /api/v1/*. It can be generated/rotated at runtime from the
                Security page (http://<vpn-ip>/pc/security, login admin/admin
                by default); a runtime token stored in NVS overrides this
                value. Generate one with:
                  python -c "import secrets; print(secrets.token_hex(24))"
                Set via sdkconfig.credentials (gitignored) or menuconfig.
                When empty and no runtime token is set, mutations are
                rejected with 403 unless PCCTL_ALLOW_NO_TOKEN is enabled.

        config PCCTL_ALLOW_NO_TOKEN
            bool "Allow mutations without an API token (development only!)"
            default n
            help
                Escape hatch for isolated lab use. NOT recommended: anyone
                who can reach the device (tailnet or LAN) could then
                power-cycle the PC. Leave disabled for real deployments.

    endmenu

    menu "PC Control - hardware safety"

        config PCCTL_HW_COOLDOWN_MS
            int "Minimum interval between hardware commands (ms)"
            default 5000
            range 1000 60000
            help
                Duplicate-request protection: a second hardware command
                within this window is rejected with 409 even when it uses
                a different request id.

        config PCCTL_FORCE_OFF_HOLD_MS
            int "FORCE_POWER_OFF default PWR_SW hold length (ms)"
            default 5000
            range 1000 15000
            help
                Seeds the runtime long-press default (Settings UI), used to
                hold PWR_SW for FORCE_POWER_OFF.

        # Physical GPIO control is always compiled in (no simulation mode).
        # Pin mapping, active level, pulse widths and per-function enables are
        # configured at runtime in the device Settings UI (/pc/settings) and
        # persisted in NVS; see pc_config.c and docs/PC_CONTROLLER.md.
        #
        # The interface circuit must be an electrically verified transistor /
        # optocoupler / isolated relay stage. Never connect a GPIO directly to
        # PWR_SW# / RESET_SW#.

    endmenu

    menu "PC Control - USB HID login"

        config PCCTL_ENABLE_HID
            bool "Enable USB HID keyboard login (native USB port)"
            default n
            help
                Compiles in the USB HID login module (pc_hid.c): on explicit
                request from the /pc UI the ESP32-S3 native USB port types
                the Windows password like a physical USB keyboard.

                Requires TinyUSB (CONFIG_TINYUSB_HID_COUNT=1) and the
                USB-Serial-JTAG console/driver to be disabled - the two
                controllers share the same pins (GPIO19/20). The serial
                console, flashing and debugging stay on the UART bridge
                (COM9). The password is RAM-only, zeroized after use and
                gated by the API token like every other mutation.

        config PCCTL_HID_MAX_LEN
            int "Maximum accepted password length (characters)"
            default 64
            range 8 127

        config PCCTL_HID_ARM_DELAY_MS
            int "Cancel window before typing starts (ms)"
            default 1000
            range 0 10000
            help
                After a submission the job stays cancellable for this long
                before the first keystroke goes out. 0 = type immediately.

        config PCCTL_HID_KEY_DELAY_MS
            int "Per-keystroke pacing (ms, key-down to key-up)"
            default 30
            range 10 200

    endmenu

    menu "PC Control - relay channels"

        config PCCTL_RELAY_MAX_CHANNELS
            int "Maximum number of relay channels"
            default 16
            range 1 16
            help
                Firmware limit for the configurable relay channel count
                (0..this), set at runtime in the Settings UI (/pc/settings,
                section "Relay channels") and stored in NVS (namespace
                "pc_ctl", key "relays"). Each configured channel reserves its
                own board-allowed GPIO; relay pins must not overlap the
                PC-control function pins. Relays always start OFF -
                energized loads are never restored after a reboot.

    endmenu


endmenu
```
